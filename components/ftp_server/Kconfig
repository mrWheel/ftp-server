## components/ftp_server/Kconfig
```kconfig
menu "FTP server component"

choice FTP_SERVER_LOG_LEVEL
    prompt "FTP server log level"
    default FTP_SERVER_LOG_LEVEL_INFO

config FTP_SERVER_LOG_LEVEL_NONE
    bool "None"
config FTP_SERVER_LOG_LEVEL_ERROR
    bool "Error"
config FTP_SERVER_LOG_LEVEL_WARN
    bool "Warning"
config FTP_SERVER_LOG_LEVEL_INFO
    bool "Info"
config FTP_SERVER_LOG_LEVEL_DEBUG
    bool "Debug"
config FTP_SERVER_LOG_LEVEL_VERBOSE
    bool "Verbose"
endchoice

config FTP_SERVER_LOG_LEVEL_VALUE
    int
    default 0 if FTP_SERVER_LOG_LEVEL_NONE
    default 1 if FTP_SERVER_LOG_LEVEL_ERROR
    default 2 if FTP_SERVER_LOG_LEVEL_WARN
    default 3 if FTP_SERVER_LOG_LEVEL_INFO
    default 4 if FTP_SERVER_LOG_LEVEL_DEBUG
    default 5 if FTP_SERVER_LOG_LEVEL_VERBOSE

endmenu
```

## examples/basic/main/Kconfig.projbuild
```kconfig
#-- SPDX-License-Identifier: GPL-3.0-or-later
#-- Copyright (C) 2026 Willem Aandewiel

menu "FTP server basic example"
choice EXAMPLE_FILESYSTEM
    prompt "Storage filesystem"
    default EXAMPLE_FILESYSTEM_LITTLEFS
config EXAMPLE_FILESYSTEM_LITTLEFS
    bool "LittleFS"
config EXAMPLE_FILESYSTEM_FATFS
    bool "FATFS with wear levelling"
endchoice
config EXAMPLE_FTP_PORT
    int "FTP control port"
    range 1 65535
    default 21
config EXAMPLE_DEVICE_HOSTNAME
    string "Device hostname"
    default "ftp-server"
endmenu
```

## main/Kconfig.projbuild
```kconfig
#-- SPDX-License-Identifier: GPL-3.0-or-later
#-- Copyright (C) 2026 Willem Aandewiel

menu "FTP server example"
choice APP_FILESYSTEM
    prompt "Storage filesystem"
    default APP_FILESYSTEM_LITTLEFS
config APP_FILESYSTEM_LITTLEFS
    bool "LittleFS"
config APP_FILESYSTEM_FATFS
    bool "FATFS with wear levelling"
endchoice
config APP_FTP_PORT
    int "FTP control port"
    range 1 65535
    default 21
config APP_DEVICE_HOSTNAME
    string "Device hostname"
    default "ftp-server"
endmenu
```

## sdkconfig.defaults
```kconfig
CONFIG_PARTITION_TABLE_CUSTOM=y
CONFIG_PARTITION_TABLE_CUSTOM_FILENAME="partitions_littlefs.csv"
CONFIG_ESPTOOLPY_FLASHSIZE_4MB=y
CONFIG_LWIP_SO_RCVTIMEO=y
CONFIG_LWIP_SO_SNDTIMEO=y
```
